/dts-v1/;
/plugin/;

/ {
    compatible = "ti,beaglebone", "ti,beaglebone-black";

    /* identification */
    part-number = "BB-NULLCAPE";

    /* version */
    version = "00A0";

    fragment@0 {
        target = <&i2c2>;
        __overlay__ {
            status = "okay";
        };
    };

};

